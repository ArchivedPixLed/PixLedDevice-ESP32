## main/Kconfig.projbuild
```kconfig
menu "Module Configuration"

config LED_PIN
    int "Led Pin"
  help
    PIN used to connected the led strip data.

config NUM_LED
    int "Led Count"
  default 0
	help
		Number of LEDs associated to the module.

config BLINK_GPIO
    int "Blink GPIO"
  help
    GPIO that correspond to the built-in LED. (default : 2)
  default 2

config MODE_HANDLER
    bool "Enables mode handler"
    default true
  help
    Uncheck if you don't want to use modes. Only the "default" mode will be available.

config MODE_PIN_1
    int "Mode Pin 1"
    depends on MODE_HANDLER
  help
    First pin to handle modes.

config MODE_PIN_2
    int "Mode Pin 2"
    depends on MODE_HANDLER
  help
    Second pin to handle modes.

config WIFI_SSID
    string "WiFi SSID"

config WIFI_PASS
    string "WiFi PASS"

config SERVER_IP
    string "Server IP"
  help
    IP of the PixLedServer

config SERVER_PORT
    string "Server port"
  help
    Port of the PixLedServer
  default "8080"

config MQTT_BROKER_IP
    string "MQTT Broker IP"
  help
    The IP of the device that host your mqtt broker.

config MQTT_BROKER_PORT
    string "MQTT Broker port"
  help
    Port of the mqtt broker.
  default "1883"

endmenu
```
